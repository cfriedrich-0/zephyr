## drivers/eeprom/Kconfig.fm24w256
```kconfig
# Copyright (c) 2021 Caspar Friedrich <c.s.w.friedrich@gmail.com>
# SPDX-License-Identifier: Apache-2.0

menuconfig EEPROM_FM24W256
	bool "Cypress FM24W256 EEPROM driver"
	select I2C
```

## drivers/eeprom/Kconfig.fm25w256
```kconfig
# Copyright (c) 2021 Caspar Friedrich <c.s.w.friedrich@gmail.com>
# SPDX-License-Identifier: Apache-2.0

menuconfig EEPROM_FM25W256
	bool "Cypress FM25W256 EEPROM driver"
	select SPI

choice
	prompt "SPI Mode"
	depends on EEPROM_FM25W256
	default EEPROM_FM25W256_SPI_MODE_0

config EEPROM_FM25W256_SPI_MODE_0
	bool "SPI Mode 0 (CPOL = 0, CPHA = 0)"

config EEPROM_FM25W256_SPI_MODE_3
	bool "SPI Mode 3 (CPOL = 1, CPHA = 1)"

endchoice
```

## dts/bindings/mtd/cypress,fm25w256.yaml
```yaml
# Copyright (c) 2021 Caspar Friedrich <c.s.w.friedrich@gmail.com>
# SPDX-License-Identifier: Apache-2.0

description: 256-Kbit (32K × 8) Serial (SPI) F-RAM

compatible: "cypress,fm25w256"

include: [eeprom-base.yaml, spi-device.yaml]

properties:
    wp-gpios:
      type: phandle-array
      required: false
      description: Write Protect pin

    hold-gpios:
      type: phandle-array
      required: false
      description: HOLD pin
```
